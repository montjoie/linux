## Documentation/devicetree/bindings/crypto/allwinner,sun8i-ce.yaml
```yaml
# SPDX-License-Identifier: GPL-2.0
%YAML 1.2
---
$id: http://devicetree.org/schemas/crypto/allwinner,sun8i-ce.yaml#
$schema: http://devicetree.org/meta-schemas/core.yaml#

title: Allwinner Crypto Engine driver

maintainers:
  - Corentin Labbe <clabbe@baylibre.com>

properties:
  compatible:
    oneOf:
      - const: allwinner,sun8i-h3-crypto
      - const: allwinner,sun8i-r40-crypto
      - const: allwinner,sun50i-a64-crypto
      - const: allwinner,sun50i-h5-crypto
      - const: allwinner,sun50i-h6-crypto

  reg:
    maxItems: 1

  interrupts:
    maxItems: 1

if:
  properties:
    compatible:
      contains:
        const: allwinner,sun50i-h6-crypto
then:
  clocks:
    items:
      - description: Bus clock
      - description: Module clock
      - description: MBus clock

  clock-names:
    items:
      - const: ahb
      - const: mod
      - const: mbus
else:
  clocks:
    items:
      - description: Bus clock
      - description: Module clock

  clock-names:
    items:
      - const: ahb
      - const: mod

  resets:
    maxItems: 1

  reset-names:
    const: ahb


required:
  - compatible
  - reg
  - interrupts
  - clocks
  - clock-names

examples:
  - |
    #include <dt-bindings/interrupt-controller/arm-gic.h>
    #include <dt-bindings/clock/sun50i-a64-ccu.h>
    #include <dt-bindings/reset/sun50i-a64-ccu.h>

    crypto: crypto@1c15000 {
      compatible = "allwinner,sun8i-h3-crypto";
      reg = <0x01c15000 0x1000>;
      interrupts = <GIC_SPI 94 IRQ_TYPE_LEVEL_HIGH>;
      clocks = <&ccu CLK_BUS_CE>, <&ccu CLK_CE>;
      clock-names = "ahb", "mod";
      resets = <&ccu RST_BUS_CE>;
      reset-names = "ahb";
    };
```

## Documentation/devicetree/bindings/crypto/allwinner,sun8i-ss.yaml
```yaml
# SPDX-License-Identifier: GPL-2.0
%YAML 1.2
---
$id: http://devicetree.org/schemas/crypto/allwinner,sun8i-ss.yaml#
$schema: http://devicetree.org/meta-schemas/core.yaml#

title: Allwinner Security System v2 driver

maintainers:
  - Corentin Labbe <corentin.labbe@gmail.com>

properties:
  compatible:
    oneOf:
      - const: allwinner,sun8i-a83t-crypto
      - const: allwinner,sun9i-a80-crypto

  reg:
    maxItems: 1

  interrupts:
    maxItems: 1

  clocks:
    items:
      - description: Bus clock
      - description: Module clock

  clock-names:
    items:
      - const: ahb
      - const: mod

  resets:
    maxItems: 1

  reset-names:
    const: ahb

required:
  - compatible
  - reg
  - interrupts
  - clocks
  - clock-names

examples:
  - |
    #include <dt-bindings/interrupt-controller/arm-gic.h>
    #include <dt-bindings/clock/sun8i-a83t-ccu.h>
    #include <dt-bindings/reset/sun8i-a83t-ccu.h>

    crypto: crypto@1c15000 {
      compatible = "allwinner,sun8i-a83t-crypto";
      reg = <0x01c15000 0x1000>;
      interrupts = <GIC_SPI 94 IRQ_TYPE_LEVEL_HIGH>;
      clocks = <&ccu CLK_BUS_SS>, <&ccu CLK_SS>;
      clock-names = "ahb", "mod";
      resets = <&ccu RST_BUS_SS>;
      reset-names = "ahb";
    };
```

## Documentation/devicetree/bindings/crypto/amlogic-crypto.txt
```
* Amlogic Crypto

Required properties:
- compatible : Should be one of
	"amlogic,meson-crypto-gxl"
- reg: Should contain the crypto HW register location and length.
- interrupts: Should contain IRQ lines for the device. one for each thread
- clocks : phandle to the clock specifiers.
- clock-names : Name of the functional clock, should be "blkmv"

Example:
	crypto: crypto@c883e000 {
		compatible = "amlogic,meson-gxl-crypto";
		reg = <0x0 0xc883e000 0x0 0x36>;
		interrupts = <GIC_SPI 188 IRQ_TYPE_EDGE_RISING>,
			     <GIC_SPI 189 IRQ_TYPE_EDGE_RISING>;
		clocks = <&clkc CLKID_BLKMV>;
		clock-names = "blkmv";
	};
```

## Documentation/devicetree/bindings/crypto/rockchip,rk3288-crypto.yaml
```yaml
# SPDX-License-Identifier: (GPL-2.0-only OR BSD-2-Clause)
%YAML 1.2
---
$id: http://devicetree.org/schemas/crypto/rockchip,rk3288-crypto.yaml#
$schema: http://devicetree.org/meta-schemas/core.yaml#

title: Rockchip Electronics And Security Accelerator

maintainers:
  - Heiko Stuebner <heiko@sntech.de>

properties:
  compatible:
    oneOf:
      - description: crypto IP present on RK3288 SoCs
        items:
          - const: rockchip,rk3288-crypto
      - description: crypto IP present on RK3328 SoCs
        items:
          - const: rockchip,rk3328-crypto
      - description: crypto IPs present on RK3399. crypto0 is the first IP with
                     RSA support, crypto1 is the second IP without RSA.
        enum:
          - rockchip,rk3399-crypto0
          - rockchip,rk3399-crypto1

  reg:
    maxItems: 1

  interrupts:
    maxItems: 1

  clocks:
    minItems: 3
    maxItems: 4

  clock-names:
    minItems: 3
    maxItems: 4

  resets:
    minItems: 1
    maxItems: 3

  reset-names:
    deprecated: true

allOf:
  - if:
      properties:
        compatible:
          contains:
            const: rockchip,rk3288-crypto
    then:
      properties:
        clock-names:
          items:
            - const: "aclk"
            - const: "hclk"
            - const: "sclk"
            - const: "apb_pclk"
          minItems: 4
  - if:
      properties:
        compatible:
          contains:
            const: rockchip,rk3328-crypto
    then:
      properties:
        clock-names:
          items:
            - const: "hclk_master"
            - const: "hclk_slave"
            - const: "sclk"
          maxItems: 3
  - if:
      properties:
        compatible:
          contains:
            enum:
              - rockchip,rk3399-crypto0
              - rockchip,rk3399-crypto1
    then:
      properties:
        clock-names:
          items:
            - const: "hclk_master"
            - const: "hclk_slave"
            - const: "sclk"
          maxItems: 3
        resets:
          minItems: 3

required:
  - compatible
  - reg
  - interrupts
  - clocks
  - clock-names
  - resets

additionalProperties: false

examples:
  - |
    #include <dt-bindings/interrupt-controller/arm-gic.h>
    #include <dt-bindings/clock/rk3288-cru.h>
    crypto@ff8a0000 {
      compatible = "rockchip,rk3288-crypto";
      reg = <0xff8a0000 0x4000>;
      interrupts = <GIC_SPI 48 IRQ_TYPE_LEVEL_HIGH>;
      clocks = <&cru ACLK_CRYPTO>, <&cru HCLK_CRYPTO>,
               <&cru SCLK_CRYPTO>, <&cru ACLK_DMAC1>;
      clock-names = "aclk", "hclk", "sclk", "apb_pclk";
      resets = <&cru SRST_CRYPTO>;
      reset-names = "crypto-rst";
    };
```

## Documentation/devicetree/bindings/crypto/sun8i-ce.txt
```
* Allwinner Crypto Engine found on H3/A64/H5/H6/R40 SoC

Required properties:
- compatible : Should be one of
	"allwinner,sun8i-h3-crypto"
	"allwinner,sun8i-r40-crypto"
	"allwinner,sun50i-a64-crypto"
	"allwinner,sun50i-h5-crypto"
	"allwinner,sun50i-h6-crypto"
- reg: Should contain the CE register location and length.
- interrupts: Should contain the IRQ line for the device. (Non secure IRQ if
  both secure/non-secure exist)
- clocks : List of clock specifiers, corresponding to AHB and CE.
- clock-names : Name of the functional clock, should be
	* "ahb" : AHB gating clock
	* "mod" : CE controller clock

Additional required properties for allwinner,sun50i-h6-crypto:
- clocks : List of MBUS clock specifiers
- clock-names : Name of the functional clock, should be
	* "mbus" : MBUS gating clock

Optional properties:
 - resets : phandle + reset specifier pair
 - reset-names : must contain "ahb"

Examples:
	crypto: crypto@1c15000 {
		compatible = "allwinner,sun8i-h3-crypto";
		reg = <0x01c15000 0x1000>;
		interrupts = <GIC_SPI 94 IRQ_TYPE_LEVEL_HIGH>;
		resets = <&ccu RST_BUS_CE>;
		reset-names = "ahb";
		clocks = <&ccu CLK_BUS_CE>, <&ccu CLK_CE>;
		clock-names = "ahb", "mod";
	};

	crypto: crypto@1904000 {
		compatible = "allwinner,sun50i-h6-crypto";
		reg = <0x01904000 0x1000>;
		interrupts = <GIC_SPI 87 IRQ_TYPE_LEVEL_HIGH>;
		clocks = <&ccu CLK_BUS_CE>, <&ccu CLK_CE>, <&ccu CLK_MBUS_CE>;
		clock-names = "ahb", "mod", "mbus";
		resets = <&ccu RST_BUS_CE>;
		reset-names = "ahb";
	};
```

## Documentation/devicetree/bindings/crypto/sun8i-ss.txt
```
* Allwinner Security System found on A80/A83T SoC

Required properties:
- compatible : Should be one of
	"allwinner,sun8i-a83t-crypto"
	"allwinner,sun9i-a0-crypto"
- reg: Should contain the SS register location and length.
- interrupts: Should contain the IRQ line for the device. (Non secure IRQ if
  both secure/non-secure exist)
- clocks : List of clock specifiers, corresponding to AHB and SS.
- clock-names : Name of the functional clock, should be
	* "ahb" : AHB gating clock
	* "mod" : SS controller clock

Optional properties:
 - resets : phandle + reset specifier pair
 - reset-names : must contain "ahb"

Examples:
	crypto: crypto@1c15000 {
		compatible = "allwinner,sun8i-h3-crypto";
		reg = <0x01c15000 0x1000>;
		interrupts = <GIC_SPI 94 IRQ_TYPE_LEVEL_HIGH>;
		resets = <&ccu RST_BUS_CE>;
		reset-names = "ahb";
		clocks = <&ccu CLK_BUS_CE>, <&ccu CLK_CE>;
		clock-names = "ahb", "mod";
	};
```

## Documentation/devicetree/bindings/hwlock/sun8i-hwspinlock.txt
```
Sun8i HWspinlock Driver
========================

Required properties:
- compatible:		Should be "allwinner,sun8i-hwspinlock"
- reg:			Contains the hwspinlock module register address space
			(base address and length)
- clocks:		A phandle to the reference clock for this device
- clock-names:		should be "ahb"
- resets:		A phandle to the reset control for this device
- reset-names:		should be "ahb"

Example:

/* sun8i-h3 */
hwspinlock: hwspinlock@1c18000 {
	compatible = "allwinner,sun8i-hwspinlock";
	reg = <0x01c18000 0x400>;
	resets = <&ccu RST_BUS_SPINLOCK>;
	reset-names = "ahb";
	clocks = <&ccu CLK_BUS_SPINLOCK>;
	clock-names = "ahb";
};
```
